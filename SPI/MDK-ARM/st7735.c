#include "st7735.h"

static ST7735_Cfg_t SPI_PIN;

#define CS_LOW()   	HAL_GPIO_WritePin(SPI_PIN.CS_Port, SPI_PIN.CS_Pin, 0)
#define CS_HIGH()  	HAL_GPIO_WritePin(SPI_PIN.CS_Port, SPI_PIN.CS_Pin, 1)
#define RS_LOW()  	HAL_GPIO_WritePin(SPI_PIN.RS_Port, SPI_PIN.RS_Pin, 1)
#define RS_HIGH()  	HAL_GPIO_WritePin(SPI_PIN.RS_Port, SPI_PIN.RS_Pin, 0)
#define DC_CMD()   	HAL_GPIO_WritePin(SPI_PIN.DC_Port, SPI_PIN.DC_Pin, 0)
#define DC_DATA()  	HAL_GPIO_WritePin(SPI_PIN.DC_Port, SPI_PIN.DC_Pin, 1)

static const uint8_t listCmd[] = {
    // cmd     length    data
    0xB1,      0x03,     0x01, 0x2C, 0x2D,
    0xB2,      0x03,     0x01, 0x2C, 0x2D,
    0xB3,      0x06,     0x01, 0x2C, 0x2D, 0x01, 0x2C, 0x2D,
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    0x00,      0x00      // endpoint marker
};

static const uint16_t Font7x10[] = {
0x0000, 0x0000, 0x0000, 0x0000, 0x0000, 0x0000, 0x0000, 0x0000, 0x0000, 0x0000,  // sp
0x1000, 0x1000, 0x1000, 0x1000, 0x1000, 0x1000, 0x0000, 0x1000, 0x0000, 0x0000,  // !
0x2800, 0x2800, 0x2800, 0x0000, 0x0000, 0x0000, 0x0000, 0x0000, 0x0000, 0x0000,  // "
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0x0000, 0x0000, 0x0000, 0x7400, 0x4C00, 0x0000, 0x0000, 0x0000, 0x0000, 0x0000,  // ~
};
static uint8_t char_buf[1024];

FontDef Font_7x10 = {7, 10, Font7x10};


void LCD_Init(ST7735_Cfg_t *config)
{
	SPI_PIN = *config;

	// Hardware Reset
	HAL_GPIO_WritePin(config->RS_Port, config->RS_Pin, GPIO_PIN_RESET);
	HAL_Delay(20);
	HAL_GPIO_WritePin(config->RS_Port, config->RS_Pin, GPIO_PIN_SET);
	HAL_Delay(150);

	// Software Reset
	WriteCommandLCD(0x01);
	HAL_Delay(150);

	// Sleep Out
	WriteCommandLCD(0x11);
	HAL_Delay(150);

	LCD_SendList(listCmd);

	// Color mode: RGB565
	WriteCommandLCD(0x3A);
	WriteDataLCD(0x05);

	// Memory Access Control
	WriteCommandLCD(0x36);
	//WriteDataLCD(0xC8);
	WriteDataLCD(0xC0);

	// Normal display mode
	WriteCommandLCD(0x13);
	HAL_Delay(10);

	// Inversion off
	WriteCommandLCD(0x20);
	//WriteCommandLCD(0x21);
	HAL_Delay(100);

	// Display ON
	WriteCommandLCD(0x29);
	HAL_Delay(100);
}

void LCD_SendList(const uint8_t *listCMD)
{
	uint8_t index, cmd, len;
	while (1)
	{
		cmd = *listCMD++;
		len = *listCMD++;
		if(cmd == 0x00 && len == 0x00) break;
		WriteCommandLCD(cmd);
		for (index = 0; index < len; index++)
		{
				WriteDataLCD(*listCMD++);
		}
	}
}

void WriteCommandLCD(uint8_t cmd){
	DC_CMD();
	CS_LOW();
	HAL_SPI_Transmit(SPI_PIN.hspi , &cmd, 1, 100);
	CS_HIGH();
}

void WriteDataLCD(uint8_t data){
	DC_DATA();
	CS_LOW();
	HAL_SPI_Transmit(SPI_PIN.hspi  , &data, 1, 100);
	CS_HIGH();
}

void SetWindow(uint8_t x1, uint8_t y1, uint8_t x2, uint8_t y2){
	WriteCommandLCD(0x2A);      // Column addr
	WriteDataLCD(0x00);
	WriteDataLCD(x1);
	WriteDataLCD(0x00);
	WriteDataLCD(x2);
	
	WriteCommandLCD(0x2B);      // Row addr
	WriteDataLCD(0x00);
	WriteDataLCD(y1);
	WriteDataLCD(0x00);
	WriteDataLCD(y2);

	WriteCommandLCD(0x2C);      // RAM Write
}

void FullDisplay(uint16_t color){
	static uint8_t line_buffer[256];
	uint8_t color_high = color >> 8;
	uint8_t color_low = color & 0xFF;

	for (uint16_t i = 0; i < 128; i++) {
			line_buffer[i * 2]     = color_high;
			line_buffer[i * 2 + 1] = color_low;
	}

	SetWindow(0, 0, 128, 160);
	DC_DATA();	
	for (uint16_t y = 0; y < 160; y++) {
		while (HAL_SPI_GetState(SPI_PIN.hspi) != HAL_SPI_STATE_READY);
		CS_LOW();
		HAL_SPI_Transmit_DMA(SPI_PIN.hspi, line_buffer, 256);
	}
}

void DrawChar(uint8_t x, uint8_t y, char ch, uint16_t foreground, uint16_t background)
{
	if (x + Font_7x10.width > 128 || y + Font_7x10.height > 160) return;

	while (HAL_SPI_GetState(SPI_PIN.hspi) != HAL_SPI_STATE_READY);

	uint16_t buf_idx = 0;
	uint8_t fg_h = foreground >> 8, fg_l = foreground & 0xFF;
	uint8_t bg_h = background >> 8, bg_l = background & 0xFF;

	for (uint16_t i = 0; i < Font_7x10.height; i++) {
		uint16_t pixelData = Font_7x10.data[(ch - 32) * Font_7x10.height + i];
		for (uint16_t j = 0; j < Font_7x10.width; j++) {
			if ((pixelData << j) & 0x8000) {
				char_buf[buf_idx++] = fg_h;
				char_buf[buf_idx++] = fg_l;
			} else {
				char_buf[buf_idx++] = bg_h;
				char_buf[buf_idx++] = bg_l;
			}
		}
	}

	SetWindow(x, y, x + Font_7x10.width - 1, y + Font_7x10.height - 1);
	DC_DATA();
	CS_LOW();
	HAL_SPI_Transmit_DMA(SPI_PIN.hspi, char_buf, buf_idx);
}

void DrawString(uint8_t x, uint8_t y, const char* str, uint16_t foreground, uint16_t background)
{
	while (*str) {
		DrawChar(x, y, *str, foreground, background);
		x += Font_7x10.width;
		str++;
	}
}

void DrawImage(uint8_t x, uint8_t y, uint8_t width, uint8_t height, const uint8_t* img) {
	while (HAL_SPI_GetState(SPI_PIN.hspi) != HAL_SPI_STATE_READY);
	SetWindow(x, y, x + width - 1, y + height - 1);  
	DC_DATA();
	CS_LOW();
	HAL_SPI_Transmit_DMA(SPI_PIN.hspi, (uint8_t*)img, width * height * 2);
}

void HAL_SPI_TxCpltCallback(SPI_HandleTypeDef *hspi)
{
	if (hspi->Instance == SPI1) {
		CS_HIGH();
	}
}